# RFC_RAT register map
Vendor: Texas Instruments
Peripheral module from a debugger description file (folder CC26x0R2F).
Registers are 32-bit, read-write, reset 0x0 unless marked. A register's access mark holds for its fields unless they carry their own. Offsets are as the file gives them; lines under a group give offsets from that group; [hi:lo] are bit positions; {n}, {i} and the like mark numbered series; 'fields as' and 'values as' point back to an identical list; <NAME> marks a mode.

## RFC_RAT — RF Core Radio Timer
0x04 RATCNT — Radio Timer Counter Value
  [31:0] CNT — Counter value. This is not writable while radio timer counter is enabled.
{0x80+4i} RATCH{i}VAL (i=0..7) — Timer Channel {i} Capture/Compare Register
  [31:0] VAL — Capture/compare value. The system CPU can safely read this register, but it is recommended to use the CPE API commands to configure it for compare mode.
